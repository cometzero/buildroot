## configs/craft_arm64_defconfig
```kconfig
BR2_aarch64=y
BR2_CCACHE=y
BR2_CCACHE_DIR="/opt/ccache"
BR2_DOWNLOAD_FORCE_CHECK_HASHES=y
BR2_SYSTEM_DHCP="eth0"
BR2_TARGET_ROOTFS_CPIO=y
BR2_TARGET_ROOTFS_CPIO_GZIP=y
# BR2_TARGET_ROOTFS_TAR is not set
```
